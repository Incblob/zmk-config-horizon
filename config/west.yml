## config/west.yml
```yaml
manifest:
  defaults:
    revision: v0.1 # version to use for this module and for ZMK
  remotes:
    - name: zmkfirmware
      url-base: https://github.com/zmkfirmware
    - name: urob
      url-base: https://github.com/urob
  projects:
    - name: zmk
      remote: zmkfirmware # urob
      revision: main
      import: app/west.yml
    - name: zmk-adaptive-key
      remote: urob
    # - name: zephyr
    #   remote: urob
    #   revision: v3.5.0+zmk-fixes
    #   clone-depth: 1
    #   import:
    #     name-blocklist:
    #       - ci-tools
    #       - hal_altera
    #       - hal_cypress
    #       - hal_infineon
    #       - hal_microchip
    #       - hal_nxp
    #       - hal_openisa
    #       - hal_silabs
    #       - hal_xtensa
    #       - hal_st
    #       - hal_ti
    #       - loramac-node
    #       - mcuboot
    #       - mcumgr
    #       - net-tools
    #       - openthread
    #       - edtt
    #       - trusted-firmware-m
  self:
    path: config
```
